## device/rockchip/.chips/rk3576/amp_mcu.its
```
/* SPDX-License-Identifier: BSD-3-Clause */
/*
 * Copyright (c) 2024 Rockchip Electronics Co., Ltd.
 */

/dts-v1/;
/ {
	description = "FIT source file for rockchip AMP";
	#address-cells = <1>;

	images {
		mcu {
			description  = "bus_mcu";       // bus_mcu or pmu_mcu
			data         = /incbin/("rtt.bin");
			type         = "standalone";
			compression  = "none";
			arch         = "arm";
			udelay       = <10000>;
			load         = <0x48200000>;
			cpu          = <0>;
			compile {
				size         = <0x00800000>;
				sys          = "rtt";    // "hal" or "rtt"
				rtt_config   = "board/evb/defconfig"
				core         = "mcu";    // "mcu" or "ap"
			};

			hash {
				algo = "sha256";
			};
		};
	};

	share {
		rpmsg_base      = <0x47c00000>;
		rpmsg_size      = <0x00500000>;
	};

	configurations {
		default = "conf";
		conf {
			description = "Rockchip AMP images";
			rollback-index = <0x0>;
			loadables = "mcu";

			signature {
				algo = "sha256,rsa2048";
				padding = "pss";
				key-name-hint = "dev";
				sign-images = "loadables";
			};

			/* - run linux on cpu0
			 * - it is brought up by amp(that run on U-Boot)
			 * - it is boot entry depends on U-Boot
			 */
			linux {
				description  = "linux-os";
				arch         = "arm64";
				cpu          = <0x000>;
				thumb        = <0>;
				hyp          = <0>;
				udelay       = <0>;
				load         = <0x42100000>;
				load_c       = <0x45480000>;
			};
		};
	};
};
```
