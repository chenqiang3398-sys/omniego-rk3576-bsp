// SPDX-License-Identifier: (GPL-2.0+ OR MIT)

/dts-v1/;

#include "rk3576.dtsi"
#include "rk3576-evb1.dtsi"
#include "rk3576-linux.dtsi"

/ {
	model = "OmniEgo RK3576 Board";
	compatible = "omniego,rk3576", "rockchip,rk3576";
};